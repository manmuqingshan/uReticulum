## firmware/heltec_v3/sdkconfig.defaults
```kconfig
# ESP-IDF defaults for uReticulum on Heltec V3.
# These get baked into sdkconfig on first idf.py build.

CONFIG_IDF_TARGET="esp32s3"

# Enable C++ exceptions — uReticulum throws on a few error paths.
CONFIG_COMPILER_CXX_EXCEPTIONS=y
CONFIG_COMPILER_CXX_EXCEPTIONS_EMG_POOL_SIZE=0

# Heltec V3 has a CP2102 USB-UART bridge wired to UART0 — not native
# ESP32-S3 USB CDC. Use default UART console so the CP2102 carries logs.
CONFIG_ESP_CONSOLE_UART_DEFAULT=y

# FreeRTOS config — recursive mutexes are used by Transport.
CONFIG_FREERTOS_USE_TIMERS=y
CONFIG_FREERTOS_HZ=1000

# Stack and task tuning. Reticulum loop is spawned with 8192 words of
# stack from app_main; the main task itself doesn't need to be huge.
CONFIG_ESP_MAIN_TASK_STACK_SIZE=4096

# Enable mbedTLS algorithms uReticulum needs (these are usually on by
# default but listed for clarity).
CONFIG_MBEDTLS_HARDWARE_AES=y
CONFIG_MBEDTLS_HARDWARE_SHA=y
CONFIG_MBEDTLS_HKDF_C=y

# Optimisation: -Os keeps flash usage down, OK for our workload.
CONFIG_COMPILER_OPTIMIZATION_SIZE=y
```
